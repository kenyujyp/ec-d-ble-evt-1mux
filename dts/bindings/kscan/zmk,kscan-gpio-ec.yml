## dts/bindings/kscan/zmk,kscan-gpio-ec.yml
```yaml
# Copyright (c) 2023 The ZMK Contributors
# SPDX-License-Identifier: MIT

description: EC keyboard matrix controller

compatible: "zmk,kscan-gpio-ec"

include: kscan.yaml

properties:
  row-gpios:
    type: phandle-array
    required: true
  mux-sel-gpios:
    type: phandle-array
    required: true
  mux0-en-gpios:
    type: phandle-array
    required: true
  discharge-gpios:
    type: phandle-array
    required: true
  io-channels:
    type: phandle-array
    required: true
  col-channels:
    type: array
    required: true
  matrix-warm-up-ms:
    type: int
    default: 5
  matrix-relax-us:
    type: int
    default: 6
  active-polling-interval-ms:
    type: int
    default: 10
    description: Time between reads in milliseconds.
  idle-polling-interval-ms:
    type: int
    default: 35
  sleep-polling-interval-ms:
    type: int
    default: 3000
  row-input-masks:
    type: array
    description: Array of masked inputs for each strobe line. Those set bits are indexes of inputs to skip for each strobe line.
```
